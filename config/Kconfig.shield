## config/Kconfig.shield
```kconfig
# Copyright (c) 2020 Pete Johanson
# SPDX-License-Identifier: MIT

config SHIELD_CORNE_LEFT
    def_bool $(shields_list_contains,corne_left,nano_oled)

config SHIELD_CORNE_RIGHT
    def_bool $(shields_list_contains,corne_right,nano_oled)
```
